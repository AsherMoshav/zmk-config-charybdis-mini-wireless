#include <behaviors/mouse_keys.dtsi>
#include <behaviors.dtsi>
#include <dt-bindings/zmk/bt.h>
#include <dt-bindings/zmk/keys.h>
#include <dt-bindings/zmk/mouse.h>
#include <dt-bindings/zmk/outputs.h>

#define U_TAPPING_TERM 200

#define U_MACRO_VA_ARGS(macro, ...) macro(__VA_ARGS__)
#define U_STRINGIFY(x) #x

#define U_NP &none // key is not present
#define U_NA &none // present but not available for use
#define U_NU &none // available but not used

#define U_MT(MOD, TAP) &u_mt MOD TAP
#define U_LT(LAYER, TAP) &u_lt LAYER TAP

#define U_BASE   0
#define U_NAV  1
#define U_SYM    2
#define U_NUM 3
#define U_FUNC    4
#define U_MEDIA  5
#define U_MOUSE  6
#define U_SCROLL  7
#define U_CODE  8

#define U_MACRO(name,...) \
/ { \
  macros { \
    name: name { \
      label = U_STRINGIFY(ZM_ ## name); \
      compatible = "zmk,behavior-macro"; \
      #binding-cells = <0>; \
      __VA_ARGS__ \
    }; \
  }; \
};

#define MIRYOKU_SHIFT_FUNCTION(NAME, BINDING, SHIFT_BINDING) \
/ { \
  behaviors { \
    NAME: NAME { \
      compatible = "zmk,behavior-mod-morph"; \
      label = U_STRINGIFY(NAME); \
      #binding-cells = <0>; \
      bindings = <BINDING>, <SHIFT_BINDING>; \
      mods = <(MOD_LSFT|MOD_RSFT)>; \
    }; \
  }; \
};

#define MIRYOKU_SHIFT_MACRO(NAME, BINDING, SHIFT_BINDING) \
U_MACRO(u_macro_ ## NAME, wait-ms = <0>; bindings = <SHIFT_BINDING>;) \
MIRYOKU_SHIFT_FUNCTION(NAME, BINDING, &u_macro_ ## NAME)

MIRYOKU_SHIFT_MACRO(u_bt_sel_0, &bt BT_SEL 0, &bt BT_SEL 0 &bt BT_CLR)
MIRYOKU_SHIFT_MACRO(u_bt_sel_1, &bt BT_SEL 1, &bt BT_SEL 1 &bt BT_CLR)
MIRYOKU_SHIFT_MACRO(u_bt_sel_2, &bt BT_SEL 2, &bt BT_SEL 2 &bt BT_CLR)
MIRYOKU_SHIFT_MACRO(u_bt_sel_3, &bt BT_SEL 3, &bt BT_SEL 3 &bt BT_CLR)
MIRYOKU_SHIFT_MACRO(u_bt_sel_4, &bt BT_SEL 4, &bt BT_SEL 4 &bt BT_CLR)
MIRYOKU_SHIFT_MACRO(u_bt_clr_all, &bt BT_SEL 0, &bt BT_SEL 0 &bt BT_CLR_ALL)

MIRYOKU_SHIFT_FUNCTION(u_out_tog, &out OUT_TOG, &out OUT_USB)

MIRYOKU_SHIFT_FUNCTION(u_caps_word, &caps_word, &kp CAPS)

/ {
    chosen { zmk,matrix_transform = &default_transform; };
};

/ {
        macros {
        email: email {
            compatible = "zmk,behavior-macro";
            #binding-cells = <0>;
            wait-ms = <20>;
            tap-ms = <20>;
            bindings = <&kp A &kp S &kp H &kp E &kp R &kp M &kp O &kp S &kp H &kp A &kp V>
              , <&kp AT>
              , <&kp G &kp M &kp A &kp I &kp L>
              , <&kp DOT>
              , <&kp C &kp O &kp M>
              ;        };

        beeri_email: beeri_email {
            compatible = "zmk,behavior-macro";
            #binding-cells = <0>;
            wait-ms = <20>;
            tap-ms = <20>;
            bindings
              = <&kp A &kp S &kp H &kp E &kp R>
              , <&kp AT>
              , <&kp B &kp E &kp E &kp R &kp I &kp P &kp R &kp I &kp N &kp T>
              , <&kp DOT>
              , <&kp C &kp O>
              , <&kp DOT>
              , <&kp I &kp L>
              ;        };

        phone: phone {
            compatible = "zmk,behavior-macro";
            #binding-cells = <0>;
            wait-ms = <20>;
            tap-ms = <20>;
            bindings
              = <&kp N0 &kp N5 &kp N0 &kp N7 &kp N5 &kp N4 &kp N9 &kp N9 &kp N6 &kp N4>
              ;        };

        id_number: id_number {
            compatible = "zmk,behavior-macro";
            #binding-cells = <0>;
            wait-ms = <20>;
            tap-ms = <20>;
            bindings
              = <&kp N2 &kp N0 &kp N8 &kp N1 &kp N8 &kp N7 &kp N4 &kp N4 &kp N3>
              ;        };

        vim_save: vim_save {
            compatible = "zmk,behavior-macro";
            #binding-cells = <0>;
            wait-ms = <20>;
            tap-ms = <20>;
            bindings
              = <&kp ESC &kp COLON &kp W &kp RET>
              ;        };

        vim_quit: vim_quit {
            compatible = "zmk,behavior-macro";
            #binding-cells = <0>;
            wait-ms = <20>;
            tap-ms = <20>;
            bindings
              = <&kp ESC &kp COLON &kp Q &kp RET>
              ;        };

        vim_quit_all: vim_quit_all {
            compatible = "zmk,behavior-macro";
            #binding-cells = <0>;
            wait-ms = <20>;
            tap-ms = <20>;
            bindings
              = <&kp ESC &kp COLON &kp Q &kp A &kp RET>
              ;        };

        arrow: arrow {
            compatible = "zmk,behavior-macro";
            #binding-cells = <0>;
            wait-ms = <20>;
            tap-ms = <20>;
            bindings
              = <&kp MINUS &kp GT>
              ;        };

        double_colon: double_colon {
            compatible = "zmk,behavior-macro";
            #binding-cells = <0>;
            wait-ms = <20>;
            tap-ms = <20>;
            bindings
              = <&kp COLON &kp COLON>
              ;        };

        compare: compare {
            compatible = "zmk,behavior-macro";
            #binding-cells = <0>;
            wait-ms = <20>;
            tap-ms = <20>;
            bindings
              = <&kp EQUAL &kp EQUAL>
              ;        };

        strict_compare: strict_compare {
            compatible = "zmk,behavior-macro";
            #binding-cells = <0>;
            wait-ms = <20>;
            tap-ms = <20>;
            bindings
              = <&kp EQUAL &kp EQUAL &kp EQUAL>
              ;        };
  };
};

/ {
    combos {
        compatible = "zmk,combos";

        LeftClickRight {
            bindings = <&mkp LCLK>;
            key-positions = <19 20>;
        };

        RightClickRight {
            bindings = <&mkp RCLK>;
            key-positions = <20 21>;
        };

        MiddleClickRight {
            bindings = <&mkp MCLK>;
            key-positions = <21 22>;
        };

        ParaLeft {
            bindings = <&kp LEFT_PARENTHESIS>;
            key-positions = <4 16>;
        };

        ParaRight {
            bindings = <&kp RIGHT_PARENTHESIS>;
            key-positions = <7 19>;
        };

        BrakLeft {
            bindings = <&kp LEFT_BRACKET>;
            key-positions = <3 15>;
        };

        BrakRight {
            bindings = <&kp RIGHT_BRACKET>;
            key-positions = <8 20>;
        };

        BraceLeft {
            bindings = <&kp LEFT_BRACE>;
            key-positions = <2 14>;
        };

        BraceRight {
            bindings = <&kp RIGHT_BRACE>;
            key-positions = <9 21>;
        };

        Delete {
            bindings = <&kp DELETE>;
            key-positions = <8 9>;
        };

        CapsWord {
            bindings = <&caps_word>;
            key-positions = <17 18>;
        };
    };

    behaviors {
        u_mt: u_mt {
      compatible = "zmk,behavior-hold-tap";
      label = "u_mt";
      #binding-cells = <2>;
      tapping_term_ms = <U_TAPPING_TERM>;
      flavor = "tap-preferred";
      bindings = <&kp>, <&kp>;
    };
    u_lt: u_lt {
      compatible = "zmk,behavior-hold-tap";
      label = "u_lt";
      #binding-cells = <2>;
      tapping_term_ms = <U_TAPPING_TERM>;
      flavor = "tap-preferred";
      bindings = <&mo>, <&kp>;
    };
u_ltms: u_ltms {
      compatible = "zmk,behavior-hold-tap";
      label = "u_ltms";
      #binding-cells = <2>;
      tapping_term_ms = <U_TAPPING_TERM>;
      flavor = "tap-preferred";
      bindings = <&mo>, <&mkp>;
    };
    u_ltm: u_ltm {
      compatible = "zmk,behavior-hold-tap";
      label = "u_ltm";
      #binding-cells = <2>;
      tapping_term_ms = <U_TAPPING_TERM>;
      flavor = "tap-preferred";
      bindings = <&lm>, <&kp>;
    };
    lm: lm {
      compatible = "zmk,behavior-macro-two-param";
      wait-ms = <0>;
      tap-ms = <0>;
      #binding-cells = <2>;
      bindings
          = <&macro_param_1to1>
          , <&macro_press &mo MACRO_PLACEHOLDER>
          , <&macro_param_2to1>
          , <&macro_press &kp MACRO_PLACEHOLDER>
          , <&macro_pause_for_release>
          , <&macro_param_2to1>
          , <&macro_release &kp MACRO_PLACEHOLDER>
          , <&macro_param_1to1>
          , <&macro_release &mo MACRO_PLACEHOLDER>
          ;
    };
    };

    keymap {
        compatible = "zmk,keymap";

        BASE {
            bindings = <
&kp ESC  &kp Q             &kp W             &kp E          &kp R               &kp T    &kp Y  &kp U               &kp I          &kp O              &kp P                 &kp BSPC
U_LT(U_MOUSE, TAB)  &u_mt LEFT_GUI A  &u_mt LEFT_ALT S  &u_mt LCTRL D  &u_mt LEFT_SHIFT F  &kp G    &kp H  &u_mt LEFT_SHIFT J  &u_mt RCTRL K  &u_mt RIGHT_ALT L  &u_mt RIGHT_GUI SQT  U_LT(U_FUNC, DEL)
U_LT(U_MEDIA, ESC)    &kp Z             &kp X             &kp C          &kp V               &kp B    &kp N  &kp M               &kp COMMA      &kp DOT            &kp SLASH              U_LT(U_FUNC, DEL)
                                             U_LT(U_SCROLL, ESC)       U_LT(U_NAV, SPACE)           U_LT(U_CODE, TAB)    U_LT(U_SYM, RET)  U_LT(U_NUM, BSPC)
            >;
        };

        NAV {
            bindings = <
&trans  &trans    &trans    &trans     &trans  &trans           &trans           &trans                &trans          &trans  &trans  &trans
&trans  &trans    &trans    &trans     &trans  &trans           &kp LEFT           &kp DOWN  &kp UP  &kp RIGHT  &u_caps_word    &trans
&trans  &trans    &trans    &trans     &trans  &trans           &kp HOME           &kp PG_DN                &kp PG_UP          &kp END  &kp INS    &trans
                            &trans     &trans  &trans           &kp RET  &kp BSPC
            >;
        };

        SYM {
            bindings = <
&trans  &kp LBRC      &kp AMPS       &kp ASTRK    &kp LPAR  &kp RBRC           &trans  &trans                 &trans   &trans              &trans &trans
&trans      &kp COLON        &kp DLLR   &kp PRCNT  &kp CARET    &kp PLUS       &trans  &trans  &u_mt RCTRL LBKT  &trans  &trans &trans
&trans      &kp TILDE  &kp EXCL  &kp AT      &kp HASH    &kp PIPE              &trans  &trans                 &trans          &trans              &trans              &trans
                               &kp LPAR      &kp RPAR    &kp UNDER             &trans     &trans
            >;
        };

        NUM {
            bindings = <
&trans  &kp LBKT   &kp N7  &kp N8   &kp N9   &kp RBKT     &trans  &trans      &trans       &trans     &trans  &trans
&trans  &kp SEMI  &kp N4  &kp N5   &kp N6   &kp EQUAL     &trans  &trans  &trans  &trans  &trans    &trans
&trans  &kp GRAVE   &kp N1  &kp N2  &kp N3  &kp BSLH      &trans        &trans            &trans             &trans           &trans        &trans
                         &kp DOT   &kp N0   &kp MINUS     &trans        &trans
            >;
        };

        FUNC {
            bindings = <
&bootloader  &kp F12  &kp F7  &kp F8    &kp F9  &kp PSCRN       &bootloader  &trans  &trans  &trans  &trans  &trans
&trans  &kp F11  &kp F4  &kp F5     &kp F6  &kp SLCK       &trans  &trans  &trans  &trans  &trans  &trans
&trans  &kp F10  &kp F1  &kp F2     &kp F3  &kp PAUSE_BREAK       &trans  &trans  &trans  &trans  &trans  &trans
                        &kp K_APP  &kp SPACE  &kp TAB    &trans  &trans
            >;
        };

        MEDIA {
            bindings = <
&trans  &trans  &trans  &trans  &trans  &trans        &trans  &trans  &trans  &trans  &trans  &trans
&trans  &trans  &trans  &trans  &trans  &trans        &kp C_PREV  &kp C_VOL_DN  &kp C_VOL_UP  &kp C_NEXT  &trans  &trans
&trans  &trans  &trans  &trans  &trans  &trans        &u_bt_sel_0  &u_bt_sel_1  &u_bt_sel_2  &u_bt_sel_3  &u_bt_sel_4  &kp C_MUTE
                        &trans  &trans  &trans        &kp C_STOP  &kp C_PP
            >;
        };

        MOUSE {
            bindings = <
&mkp MB4  &trans  &trans  &trans     &trans  &trans       &trans  &trans  &trans  &trans  &trans  &trans
&mkp MB5  &trans  &trans  &trans     &trans  &trans       &trans  &trans  &trans  &trans  &trans  &trans
&trans  &trans  &trans  &trans     &trans  &trans       &trans  &trans  &trans  &trans  &trans  &trans
                        &trans  &mkp LCLK  &u_ltms U_CODE RCLK    &trans  &trans
            >;
        };
        SCROLL {
            bindings = <
&trans  &trans  &trans  &trans  &trans  &trans    &trans  &trans  &trans  &trans  &trans  &trans
&trans  &trans  &trans  &trans  &trans  &trans    &trans  &trans  &trans  &trans  &trans  &trans
&trans  &trans  &trans  &trans  &trans  &trans    &trans  &trans  &trans  &trans  &trans  &trans
                        &trans  &trans  &trans    &trans  &trans
            >;
        };
        CODE {
            bindings = <
&trans  &email  &beeri_email  &phone  &id_number  &trans    &trans  &trans  &trans  &vim_quit_all             &vim_quit  &trans
&trans  &trans  &trans  &trans  &trans  &trans    &arrow            &vim_save  &trans  &trans  &trans  &trans
&trans  &trans  &trans  &trans  &trans  &trans    &trans  &trans  &trans  &trans  &trans  &trans
                        &trans  &trans  &trans    &trans  &trans
            >;
        };
    };
};
